## conf/layer.conf
```bitbake
# We have a conf and classes directory, add to BBPATH
BBPATH .= ":${LAYERDIR}"

# We have recipes-* directories, add to BBFILES
BBFILES += "${LAYERDIR}/recipes-*/*/*.bb \
            ${LAYERDIR}/recipes-*/*/*.bbappend"

BBFILE_COLLECTIONS += "meta-helios-splashscreen"
BBFILE_PATTERN_meta-helios-splashscreen = "^${LAYERDIR}/"
BBFILE_PRIORITY_meta-helios-splashscreen = "4"

LAYERDEPENDS_meta-helios-splashscreen = "core"
LAYERSERIES_COMPAT_meta-helios-splashscreen = "scarthgap nanbield langdale kirkstone dunfell mickledore"
```
